#define UART_GLOBAL
#include "include.h"

////////////////////////////////////////////////////////////////////////////////
// 功能描述 : 串口0配置
// 输入参数 : 
// 返回参数 : 
// 说明     : 8位数据，115200 
////////////////////////////////////////////////////////////////////////////////
void UART_Init()
{
	 Timer1_Init();       // Timer1 自动重装模式2
	 SCON0 |= 0x90;       // 9位数据
	 ES0 = 1;             // Uart0 interrupt Enable
   PS0 = 1;             // Uart0 interrupt set to high priority level   	
}
////////////////////////////////////////////////////////////////////////////////
// 功能描述 : 串口中断入口
// 输入参数 : 
// 返回参数 : 
// 说明     : 
////////////////////////////////////////////////////////////////////////////////
void interrupt_UART0(void) interrupt 4
{

	 if (RI0)
	 {
		  RI0 = 0;
		  if ( (uart.rIndex < UART_BUF_LEN)&&(uart.rFlag == OFF) )
		  {
			   uart.rBuffer[uart.rIndex++] = SBUF0;		
			   uart.rTimer = RCV_OVER_TIMER;
		  }
	 }

}
////////////////////////////////////////////////////////////////////////////////
// 功能描述 : 串口0发送一个字节数据
// 输入参数 : 
// 返回参数 : 
// 说明     :  
////////////////////////////////////////////////////////////////////////////////
void Usart1_SendByte(UINT8 byte)
{
		
	  //while(TI);
	 	SBUF0 = byte;           
		while(!TI0);
		TI0 = 0;             
}